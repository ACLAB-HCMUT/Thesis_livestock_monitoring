## CMakeLists.txt
```
# SPDX-License-Identifier: Apache-2.0

cmake_minimum_required(VERSION 3.20.0)

set(BOARD xiao_ble/nrf52840/sense)

find_package(Zephyr REQUIRED HINTS $ENV{ZEPHYR_BASE})
project(do_an)


FILE(GLOB app_sources src/*.cpp)

add_subdirectory(src/global)
add_subdirectory(src/thread)
add_subdirectory(src/lora)
add_subdirectory(src/gps)
add_subdirectory(src/button)
add_subdirectory(src/ble)
add_subdirectory(src/flash)

target_sources(app  
                    PRIVATE 
                        src/main.cpp)
```

## prj.conf
```kconfig
CONFIG_CPP=y
CONFIG_REQUIRES_FULL_LIBCPP=y

CONFIG_I2C=y
CONFIG_SENSOR=y
CONFIG_CBPRINTF_FP_SUPPORT=y

# Enable Bluetooth peripheral
CONFIG_BT=y
CONFIG_BT_PERIPHERAL=y

# GAP attributes
CONFIG_BT_DEVICE_NAME="LIVESTOCK NODE"
CONFIG_BT_DEVICE_APPEARANCE=1344

CONFIG_FLASH=y
CONFIG_NVS=y
CONFIG_LOG=y
CONFIG_LOG_MODE_IMMEDIATE=y
CONFIG_NVS_LOG_LEVEL_DBG=y
CONFIG_REBOOT=y
CONFIG_MPU_ALLOW_FLASH_WRITE=y

# Config UART
# CONFIG_GPIO=y
# CONFIG_UART_ASYNC_API=y
# CONFIG_UART_0_INTERRUPT_DRIVEN=n
# CONFIG_UART_0_ASYNC=y
CONFIG_SERIAL=y
CONFIG_UART_USE_RUNTIME_CONFIGURE=y
```

## src/main.cpp
```c
extern "C" {
#include <zephyr/kernel.h>
}

#include "flash.hpp"
#include "global.hpp"

struct k_thread blink_led_thread;
K_THREAD_STACK_DEFINE(blink_led_stack_area, 1024);
extern void blink_led_entry(void *p1, void *p2, void *p3);

struct k_thread button_thread;
K_THREAD_STACK_DEFINE(button_stack_area, 1024);
extern void button_entry(void *p1, void *p2, void *p3);

struct k_thread read_lora_thread;
K_THREAD_STACK_DEFINE(read_lora_stack_area, 1024);
extern void read_lora_entry(void *p1, void *p2, void *p3);

struct k_thread gps_thread;
K_THREAD_STACK_DEFINE(gps_stack_area, 1024);
extern void gps_entry(void *p1, void *p2, void *p3);

int main(void)
{
	k_thread_create(&blink_led_thread, (k_thread_stack_t *)&blink_led_stack_area,
			K_THREAD_STACK_SIZEOF(blink_led_stack_area), blink_led_entry, NULL, NULL,
			NULL, 5, 0, K_NO_WAIT);

	k_thread_create(&button_thread, (k_thread_stack_t *)&button_stack_area,
			K_THREAD_STACK_SIZEOF(button_stack_area), button_entry, NULL, NULL, NULL, 5,
			0, K_NO_WAIT);

	k_thread_create(&read_lora_thread, (k_thread_stack_t *)&read_lora_stack_area,
			K_THREAD_STACK_SIZEOF(read_lora_stack_area), read_lora_entry, NULL, NULL,
			NULL, 5, 0, K_NO_WAIT);
	
	k_thread_create(&gps_thread, (k_thread_stack_t *)&gps_stack_area,
			K_THREAD_STACK_SIZEOF(gps_stack_area), gps_entry, NULL, NULL, NULL, 5,
			0, K_NO_WAIT);

	init_flash_memory();
	init_cow_addr();

	while (1) {
		k_msleep(1000);
	}
	return 0;
}
```

## include/global.h
```c
#include <SPI.h>
#include <LoRa.h>
#include <TinyGPSPlus.h>
#include <SoftwareSerial.h>
#include <Arduino_FreeRTOS.h>
#include <Arduino.h>

#define GPS             0
#define Acceleration    1

#define localAddress    0x01
#define gatewayAddress  0xBB    
#define broadcast       0xFF      

#define gpsPacketSize       12
#define start_idx           0
#define targetAddress_idx   1
#define opcode_idx          2
#define lat_idx             3            
#define lng_idx             7
#define end_idx             11

/* declare Software Serial pin*/
const byte rxPin = 3;
const byte txPin = 4;

/* Lora Configuration */
const long frequency = 915E6; // LoRa Frequency
const uint8_t csPin = 10;     // LoRa radio chip select
const uint8_t resetPin = 9;   // LoRa radio reset
const uint8_t irqPin = 2;     // change for your board; must be a hardware interrupt pin

/* declare GPS packet */
byte gpsPacket[gpsPacketSize];

/* declare Software UART */
SoftwareSerial mySerial(rxPin, txPin);

/* declare GPS */
TinyGPSPlus gps;
```
